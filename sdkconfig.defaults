## sdkconfig.defaults
```kconfig
# Minimal configuration for BT enabled on ESP32-C6
CONFIG_BT_ENABLED=y
CONFIG_BT_NIMBLE_ENABLED=y
CONFIG_BT_NIMBLE_EXT_ADV=n

# Compiler optimization
CONFIG_COMPILER_OPTIMIZATION_SIZE=y

# LVGL configuration (Kconfig-based, skip lv_conf.h file)
CONFIG_LV_CONF_SKIP=y
CONFIG_LV_COLOR_DEPTH_16=y
CONFIG_LV_MEM_SIZE_KILOBYTES=32
CONFIG_LV_OS_FREERTOS=y
CONFIG_LV_USE_FREERTOS_TASK_NOTIFY=y
CONFIG_LV_DRAW_SW_SUPPORT_RGB565_SWAPPED=y
CONFIG_LV_USE_LOG=n
CONFIG_LV_BUILD_EXAMPLES=n
CONFIG_LV_BUILD_DEMOS=n

# Fonts: only what we use (14, 18, 24)
CONFIG_LV_FONT_MONTSERRAT_14=y
CONFIG_LV_FONT_MONTSERRAT_18=y
CONFIG_LV_FONT_MONTSERRAT_24=y
CONFIG_LV_FONT_MONTSERRAT_36=y
CONFIG_LV_FONT_MONTSERRAT_48=y
CONFIG_LV_FONT_SOURCE_HAN_SANS_SC_16_CJK=y

# Custom larger partition table to accommodate large CJK font tables
CONFIG_PARTITION_TABLE_CUSTOM=y
CONFIG_PARTITION_TABLE_FILENAME="partitions_singleapp_large.csv"


# Disable unused color backends (only need RGB565 variants)
CONFIG_LV_DRAW_SW_SUPPORT_RGB565A8=n
CONFIG_LV_DRAW_SW_SUPPORT_RGB888=n
CONFIG_LV_DRAW_SW_SUPPORT_XRGB8888=n
CONFIG_LV_DRAW_SW_SUPPORT_ARGB8888=n
CONFIG_LV_DRAW_SW_SUPPORT_ARGB8888_PREMULTIPLIED=n
CONFIG_LV_DRAW_SW_SUPPORT_L8=n
CONFIG_LV_DRAW_SW_SUPPORT_AL88=n
CONFIG_LV_DRAW_SW_SUPPORT_A8=n
CONFIG_LV_DRAW_SW_SUPPORT_I1=n

# Disable unused themes (we style manually)
CONFIG_LV_USE_THEME_SIMPLE=n
CONFIG_LV_USE_THEME_MONO=n

# Disable unused LVGL widgets (only keep LABEL, ARC, FLEX)
CONFIG_LV_USE_ANIMIMG=n
CONFIG_LV_USE_ARCLABEL=n
CONFIG_LV_USE_BAR=n
CONFIG_LV_USE_BUTTON=n
CONFIG_LV_USE_BUTTONMATRIX=n
CONFIG_LV_USE_CALENDAR=n
CONFIG_LV_USE_CALENDAR_HEADER_ARROW=n
CONFIG_LV_USE_CALENDAR_HEADER_DROPDOWN=n
CONFIG_LV_USE_CANVAS=n
CONFIG_LV_USE_CHART=n
CONFIG_LV_USE_CHECKBOX=n
CONFIG_LV_USE_DROPDOWN=n
CONFIG_LV_USE_GRID=n
CONFIG_LV_USE_IMAGE=n
CONFIG_LV_USE_IMAGEBUTTON=n
CONFIG_LV_USE_KEYBOARD=n
CONFIG_LV_USE_LED=n
CONFIG_LV_USE_LINE=n
CONFIG_LV_USE_LIST=n
CONFIG_LV_USE_MENU=n
CONFIG_LV_USE_MSGBOX=n
CONFIG_LV_USE_ROLLER=n
CONFIG_LV_USE_SCALE=n
CONFIG_LV_USE_SLIDER=n
CONFIG_LV_USE_SPAN=n
CONFIG_LV_USE_SPINBOX=n
CONFIG_LV_USE_SPINNER=n
CONFIG_LV_USE_SWITCH=n
CONFIG_LV_USE_TABLE=n
CONFIG_LV_USE_TABVIEW=n
CONFIG_LV_USE_TEXTAREA=n
CONFIG_LV_USE_TILEVIEW=n
CONFIG_LV_USE_WIN=n

# Disable unused LVGL features
CONFIG_LV_USE_OBJ_ID=n
CONFIG_LV_USE_OBJ_PROPERTY=n
CONFIG_LV_USE_SYSMON=n
CONFIG_LV_USE_PERF_MONITOR=n
CONFIG_LV_USE_FILE_EXPLORER=n
CONFIG_LV_USE_SDL=n
CONFIG_LV_USE_BMP=n
CONFIG_LV_USE_GIF=n
CONFIG_LV_USE_TJPGD=n
CONFIG_LV_USE_LODEPNG=n
CONFIG_LV_USE_LIBJPEG_TURBO=n
CONFIG_LV_USE_LIBPNG=n
CONFIG_LV_USE_BARCODE=n
CONFIG_LV_USE_QRCODE=n
CONFIG_LV_USE_MONKEY=n
CONFIG_LV_USE_GESTURE_RECOGNITION=n
CONFIG_LV_USE_SNAPSHOT=n
CONFIG_LV_USE_PROFILER_BUILTIN=n
CONFIG_LV_USE_FREETYPE=n
CONFIG_LV_USE_TINY_TTF=n
CONFIG_LV_USE_OBSERVER=n
CONFIG_LV_USE_FLOAT=n
CONFIG_LV_USE_BIDI=n
CONFIG_LV_USE_FONT_COMPRESSED=n
CONFIG_LV_USE_LZ4=n
CONFIG_LV_USE_RLE=n
CONFIG_LV_USE_MATRIX=n
CONFIG_LV_USE_ASSERT_STYLE=n
CONFIG_LV_USE_ASSERT_OBJ=n
CONFIG_LV_USE_ASSERT_MEM_INTEGRITY=n
CONFIG_LV_DRAW_SW_COMPLEX_GRADIENTS=n
CONFIG_LV_USE_DRAW_VG_LITE=n
CONFIG_LV_USE_NATIVE_HELIUM_ASM=n
```
